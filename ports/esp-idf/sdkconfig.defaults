## ports/esp-idf/sdkconfig.defaults
```kconfig
CONFIG_PARTITION_TABLE_CUSTOM=y
CONFIG_PARTITION_TABLE_CUSTOM_FILENAME="ports/esp-idf/partitions.csv"
CONFIG_PARTITION_TABLE_FILENAME="ports/esp-idf/partitions.csv"

CONFIG_ESPTOOLPY_FLASHSIZE_8MB=y

CONFIG_LWIP_LOCAL_HOSTNAME="libmcu"

CONFIG_BT_ENABLED=y
CONFIG_BT_NIMBLE_ENABLED=y

CONFIG_ESP_TLS_INSECURE=y
CONFIG_ESP_TLS_SKIP_SERVER_CERT_VERIFY=y
```
